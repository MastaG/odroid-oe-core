## odroid-os/conf/distro/odroid-os-common.conf
```bitbake
#@TYPE: Distribution
#@NAME: Odroid-OS
#@DESCRIPTION: Embedded Linux Distribution Configuration for STB's

require reporefs.conf

DISTRO_NAME ?= "odroid-os"
DISTRO_HOST ?= "${@os.uname()[1]}"
DISTRO_VERSION ?= "release"
DISTRO_TYPE ?= "release"

IPKG_VARIANT = "opkg"

FEED_NAME ?= "${DISTRO_NAME}-${DISTRO_VERSION}"
DISTRO_FEED_URI ?= "https://${DISTRO_HOST}/feeds/${FEED_NAME}"
DISTRO_FEED_PREFIX ?= "${DISTRO_NAME}"

IMAGE_NAME = "${IMAGE_BASENAME}-${DISTRO_VERSION}-${MACHINE}"
IMAGE_LINK_NAME = ""
CACHE ?= "${TMPDIR}/cache/${LIBC}/${MACHINE}"
DEPLOY_DIR ?= "${TMPDIR}/deploy/${LIBC}"
DEPLOY_DIR_IMAGE = "${DEPLOY_DIR}/images/${MACHINE}"

TOOLCHAIN = "clang"
QEMU_TARGETS = "arm aarch64 x86_64"

NO32LIBS ??= "1"
TCLIBCAPPEND = ""

PREFERRED_PROVIDER_libfribidi = "libfribidi"
PREFERRED_PROVIDER_libcrypto = "openssl"
PREFERRED_PROVIDER_libssl = "openssl"
PREFERRED_PROVIDER_virtual/libgl = "mesa"
PREFERRED_PROVIDER_virtual/libgles1 = "mesa"
PREFERRED_PROVIDER_virtual/libgles2 = "mesa"
PREFERRED_PROVIDER_virtual/mesa = "mesa"
PREFERRED_PROVIDER_virtual/egl = "mesa"

# Gstreamer 1.x
GST_VERSION = "1.0"

LICENSE_FLAGS_WHITELIST = "commercial"
COMMERCIAL_AUDIO_PLUGINS ?= "gst-plugins-ugly-mad gst-plugins-ugly-mpegaudioparse"
COMMERCIAL_VIDEO_PLUGINS ?= "gst-plugins-ugly-mpeg2dec gst-plugins-ugly-mpegstream gst-plugins-bad-mpegvideoparse"

DISTRO_FEATURES_BACKFILL_CONSIDERED ?= "sysvinit"
DISTRO_FEATURES ?= "opengl alsa bluetooth bluez5 argp ipv6 ext2 xattr smbfs pci wifi-extra largefile wifi nfs zeroconf pam pulseaudio wayland mplt systemd ${DISTRO_FEATURES_LIBC}"

QA_LOGFILE = "${TMPDIR}/qa.log"

OEINCLUDELOGS ?= "yes"
KERNEL_CONSOLE ?= "ttyS0"

BB_GENERATE_MIRROR_TARBALLS ??= "0"

# Missing checksums should raise an error
BB_STRICT_CHECKSUM = "0"

# Don't grab feeds for lower level archs, e.g. mips32el should not
# attempt to fetch mipsel, and armv7 need not fetch armv5 etcetera.
DISTRO_FEED_ARCHS = "all ${TUNE_PKGARCH} ${MACHINE_ARCH}"

# Use OpenSSL only
PACKAGECONFIG_pn-curl = "${@bb.utils.contains("DISTRO_FEATURES", "ipv6", "ipv6", "", d)} ssl proxy zlib libssh2"
PACKAGECONFIG_pn-openldap = "openssl modules mdb ldap meta monitor null passwd shell proxycache dnssrv ${@bb.utils.contains('DISTRO_FEATURES', 'ipv6', 'ipv6', '', d)}"
PACKAGECONFIG_pn-neon = "expat openssl libproxy webdav zlib"

# Allow java, svn and unzip executed on host
HOSTTOOLS += "java svn unzip"
```

## odroid-os/conf/distro/odroid-os.conf
```bitbake
#@TYPE: Distribution
#@NAME: Odroid-OS
#@DESCRIPTION: Embedded Linux Distribution Configuration for STB's

require odroid-os-common.conf

VIRTUAL-RUNTIME_init_manager = "systemd"
VIRTUAL-RUNTIME_initscripts = "systemd-compat-units"
```

## odroid-os/conf/layer.conf
```bitbake
# We have a conf and classes directory, append to BBPATH
BBPATH .= ":${LAYERDIR}"

# We have a recipes directory, add to BBFILES
BBFILES += "${LAYERDIR}/recipes-*/*/*.bb ${LAYERDIR}/recipes-*/*/*.bbappend"

BBFILE_COLLECTIONS += "odroid-os-layer"
BBFILE_PATTERN_odroid-os-layer := "^${LAYERDIR}/"
BBFILE_PRIORITY_odroid-os-layer = "7"

ODROIDOS_BASE := '${@os.path.normpath("${LAYERDIR}/../")}'
# Prevent current directory creeping into sstate objects. Otherwise, building
# in another TOPDIR will cause recipes using this variable to be rebuilt.
ODROIDOS_BASE[vardepvalue] = 'odroid-os'

LICENSE_PATH += "${LAYERDIR}/licenses"
LAYERDEPENDS_odroid-os-layer = "core"
LAYERSERIES_COMPAT_odroid-os-layer = "sumo thud warrior zeus dunfell gatesgarth hardknott honister"
```
